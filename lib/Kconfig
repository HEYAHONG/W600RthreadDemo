## lib/Kconfig
```kconfig
config APP_USING_JSONCPP
    bool "using jsoncpp"
    default n

config APP_USING_PAHOMQTT
    bool "using pahomqtt"
    default y
    select PKG_USING_PAHOMQTT
    select MQTT_USING_TLS
    select PKG_USING_PAHOMQTT_LATEST

if APP_USING_PAHOMQTT

config PKG_PAHOMQTT_VER
    string
    default "latest"
     
endif
```

## src/Kconfig
```kconfig
config APP_W60X
    bool
    default y
    select  ARCH_ARM_CORTEX_M3
    depends on SOC_W600_A8xx || SOC_W601_A8xx

config APP_AUTOCONFIGURE_WLAN_STA
    bool "autoconfigure wlan sta"
    default y

if APP_AUTOCONFIGURE_WLAN_STA
menu "Autoconfigure WlanSta"

config APP_AUTOCONFIGURE_WLAN_STA_SSID_FILE_PATH
    string "autoconfigure wlan sta ssid file"
    default "/wlan_ssid"

config APP_AUTOCONFIGURE_WLAN_STA_PASSWORD_FILE_PATH
    string "autoconfigure wlan sta password file"
    default "/wlan_psk"

config APP_AUTOCONFIGURE_WLAN_STA_SSID_FAILBACK
    string "autoconfigure wlan sta ssid(failback)"
    default "ESP32"

config APP_AUTOCONFIGURE_WLAN_STA_PASSWORD_FAILBACK
    string "autoconfigure wlan sta password(failback)"
    default "12345678"

endmenu
endif


config APP_AUTOSTART_ONESHOT
    bool "autostart oneshot"
    default y
    depends on WM_USING_ONESHOT

if APP_AUTOSTART_ONESHOT
menu "Autostart oneshot"

choice
    prompt "oneshot mode"
    default  APP_AUTOSTART_ONESHOT_MODE_APWEB

config APP_AUTOSTART_ONESHOT_MODE_UDP
    bool "udp"

config APP_AUTOSTART_ONESHOT_MODE_APSOCKET
    bool "apsocket"

config APP_AUTOSTART_ONESHOT_MODE_APWEB
    bool "apweb"

endchoice

config APP_AUTOSTART_ONESHOT_MODE
    int
    default 0 if APP_AUTOSTART_ONESHOT_MODE_UDP
    default 1 if APP_AUTOSTART_ONESHOT_MODE_APSOCKET
    default 2 if APP_AUTOSTART_ONESHOT_MODE_APWEB

config APP_AUTOSTART_ONESHOT_AP_SSID
    string "oneshot ap ssid"
    default "W600-OneShot"

config APP_AUTOSTART_ONESHOT_AP_PASSWORD
    string "oneshot ap password"
    default ""

config APP_AUTOSTART_ONESHOT_AP_STOP_ON_ONESHOT_SUCCESS
    bool "stop ap when oneshot success"
    default y

endmenu
endif

config APP_AUTORESET_ON_ERROR
    bool "autoreset on error"
    default y

if  APP_USING_PAHOMQTT

choice APP_MQTT_PROTOCOL
    prompt "MQTT Protocol"
    default APP_MQTT_PROTOCOL_HELLO

config APP_MQTT_PROTOCOL_HELLO
    bool "hello"
    

endchoice

config APP_MQTT_URI
    string "MQTT Uri"
    default "tcp://mqtt.hyhsystem.cn:1883"

endif
```
